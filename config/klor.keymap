/*
 * KLOR (polydactyl, 2x rotary encoder) keymap wrapper.
 *
 * urob's base.keymap holds all the logic via a board-agnostic ZMK_BASE_LAYER
 * macro. This file maps urob's 34 inner keys onto KLOR's physical matrix and
 * fills the extra KLOR positions (outer pinky column on the mid/bottom rows,
 * encoder push switches, and the 2 extra thumbs per side).
 *
 *                              KLOR matrix (positions 0..43, see key-labels/klor.h)
 *  ╭───────────────────────────╮ ╭───────────────────────────╮
 *  │ LT4 LT3 LT2 LT1 LT0       │ │       RT0 RT1 RT2 RT3 RT4 │
 *  │ LM5 LM4 LM3 LM2 LM1 LM0   │ │   RM0 RM1 RM2 RM3 RM4 RM5 │
 *  │ LB5 LB4 LB3 LB2 LB1 LB0 ⊙ │ │ ⊙ RB0 RB1 RB2 RB3 RB4 RB5 │   ⊙ = encoder push (LEC/REC)
 *  ╰────────╮ LH3 LH2 LH1 LH0  │ │  RH0 RH1 RH2 RH3 ╭────────╯
 *           ╰──────────────────╯ ╰──────────────────╯
 *
 * The LT/RT/LM/RM/LB/RB/LH/RH args below are the 5/5/5/5/5/5/2/2 inner keys
 * that urob's base.keymap passes in. Everything else here is layer-constant.
 */

#define CONFIG_WIRELESS   // nice_nano_v2 is BLE: enables BT keys + USB/BLE outputs.

#define ZMK_BASE_LAYER(name, LT, RT, LM, RM, LB, RB, LH, RH)                   \
    ZMK_LAYER(name,                                                            \
        /* top    pos 0-9  */ LT RT                                            \
        /* mid    pos 10-21*/ &kp LSHFT  LM  RM  &kp SQT                       \
        /* bottom pos 22-35*/ &kp LCTRL  LB  &kp C_MUTE  &kp C_PP  RB  &kp RET \
        /* thumbs pos 36-43*/ &kp ESC  &thumb_gui LGUI TAB  LH  RH  &mo SYS  &kp BSPC \
        /* encoders: left = volume, right = page scroll */                     \
        , &inc_dec_kp C_VOL_UP C_VOL_DN  &inc_dec_kp PG_UP PG_DN)

#include <dt-bindings/zmk-unicode/uc.h>
#include <zmk-helpers/key-labels/klor.h>
#include "base.keymap"

/* Gui/Tab thumb. Not &mt: base.keymap tunes &mt for the NAV cluster
 * (tap-preferred + hold-trigger-key-positions = <0>), which would resolve
 * Gui+key chords as Tab unless the thumb is held past the tapping term. */
ZMK_HOLD_TAP(thumb_gui, bindings = <&kp>, <&kp>; flavor = "balanced";
             tapping-term-ms = <200>; quick-tap-ms = <QUICK_TAP_MS>;)

/* Unicode input mode. Linux IBus (Ctrl+Shift+U) by default. Change to match
 * your OS: UC_MODE_MACOS | UC_MODE_LINUX | UC_MODE_LINUX_ALT |
 *          UC_MODE_WIN_COMPOSE | UC_MODE_WIN_ALT | UC_MODE_EMACS
 * (UC_MODE_LINUX_ALT is a fallback if some Linux apps choke on IBus.)      */
&uc {
    default-mode = <UC_MODE_LINUX>;
};
